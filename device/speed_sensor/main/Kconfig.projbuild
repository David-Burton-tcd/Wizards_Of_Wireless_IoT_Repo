## device/speed_sensor/main/Kconfig.projbuild
```kconfig
menu "Speed Sensor Configuration"

config WIFI_SSID
    string "WiFi network SSID"
    default ""
    help
        WiFi network SSID.

config WIFI_PASSWORD
    string "WiFi network password"
    default ""
    help
        WiFi network password.

config FIRMWARE_UPGRADE_URL
    string "Fimware upgrade HTTPS url"
    default "https://34.89.91.208:8443/hello-world.bin"
    help
        Fimware upgrade HTTPS url.

config MQTT_BROKER_URI
    string "MQTT SSL broker uri"
    default "mqtts://34.89.91.208:8883"
    help
        MQTT SSL broker uri.

config MQTT_BROKER_USER
    string "MQTT SSL user"
    default ""
    help
        MQTT SSL user.

config MQTT_BROKER_PASSWORD
    string "MQTT SSL user password"
    default ""
    help
        MQTT SSL user password.

endmenu
```

## device/speed_sensor/sdkconfig.defaults
```kconfig
# Default sdkconfig parameters to use the OTA
# partition table layout, with a 4MB flash size
CONFIG_ESPTOOLPY_FLASHSIZE_4MB=y
#CONFIG_PARTITION_TABLE_TWO_OTA=y
#CONFIG_PARTITION_TABLE_SINGLE_APP_LARGE=y

# custom partition table
CONFIG_PARTITION_TABLE_CUSTOM=y
CONFIG_PARTITION_TABLE_CUSTOM_FILENAME="custom_partitions.csv"
CONFIG_PARTITION_TABLE_FILENAME="custom_partitions.csv"
CONFIG_PARTITION_TABLE_OFFSET=0x8000
CONFIG_PARTITION_TABLE_MD5=y

# Certificate bundle configuration
CONFIG_MBEDTLS_CERTIFICATE_BUNDLE_DEFAULT_CMN=y
CONFIG_MBEDTLS_CUSTOM_CERTIFICATE_BUNDLE=y
CONFIG_MBEDTLS_CUSTOM_CERTIFICATE_BUNDLE_PATH="certificates/cert.pem"

# BLE related configuration
CONFIG_BT_ENABLED=y
CONFIG_BT_BLE_50_FEATURES_SUPPORTED=n
CONFIG_BT_BLE_42_FEATURES_SUPPORTED=y
CONFIG_BT_LE_50_FEATURE_SUPPORT=n
```
